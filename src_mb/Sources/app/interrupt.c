#include <intrins.h>
#include <string.h>
// std library
#include "c51_type.h"
// mcu_library
#include "hal_sys.h"
#include "hal_gpio.h"
#include "hal_timer.h"
// #include <STC8H.h>
// #include "STC8H_UART.h"
// #include "mcu_library.h"
// config
// #include "board.h"
// #include "config.h"
/*******************************************************************************
 * components
 ******************************************************************************/
#include "thyristor.h"
// #include "sys.h"
// #include "uart.h"
// #include "uart_dis.h"
/*******************************************************************************
 * app
 ******************************************************************************/
#include "load.h"

#define ISR_NUM 32

/*******************************************************************************
 * #0
 * INT0 外部中断0
 ******************************************************************************/
void ISR_INT0_Handler() interrupt 0
{
}

/*******************************************************************************
 * #1
 * Timer0 定时器0
 ******************************************************************************/
void ISR_Timer0_Handler() interrupt 1
{
}

/*******************************************************************************
 * #2
 * INT1 外部中断1
 ******************************************************************************/
void ISR_INT1_Handler() interrupt 2
{
}

/*******************************************************************************
 * #3
 * Timer1 定时器1
 ******************************************************************************/
void ISR_Timer1_Handler() interrupt 3
{
}

// extern uint16_t uart_test_1;
// extern uint8_t uart_test_buf;

/*******************************************************************************
 * #4
 * UART1 串口1
 ******************************************************************************/
// void ISR_Uart1_Handler() interrupt 4
// {
//     if (RI)
//     {
//         RI = 0;
//         if (uart_test_1 < 0xFFFF)
//             uart_test_1++;
//         uart_test_buf = UART1_Buf;
//     }

//     if (TI)
//     {
//         TI = 0;
//         IO_Out_Flip(GPIO_P1, 6);
//     }
// }

// uint8_t aaa = 0;

/*******************************************************************************
 * #12
 * Timer2 定时器2
 ******************************************************************************/
void ISR_Timer2_Handler() interrupt 12
{
    static data uint8_t triac_cnt = 0;

    hal_uptime++;

    triac_cnt++;
    if (triac_cnt == 20)
    {
        triac_cnt = 0;
        triac_timer_handler(&G_LOAD.triac);
    }

    if (triac_cnt == 0)
    {
        IO_Out_L(1, 4);
    }
    else if (triac_cnt == 10)
    {
        IO_Out_H(1, 4);
    }

    // aaa++;
    // if (aaa == 100)
    // {
    //     aaa = 0;
    //     IO_Out_Flip(1, 3);
    // }

    /***************************************************************************
     * uart timeout tick
     **************************************************************************/
    // UART_Timeout_Dec(&gUart.tr0);

    /***************************************************************************
     * sysTick 1ms
     **************************************************************************/
    // gSys.flags.tick_1ms = 1;

    /***************************************************************************
     * sysTick 10ms
     **************************************************************************/
    // if (gSys.cnt_10ms < SYS_TICK_10MS_SET)
    //     gSys.cnt_10ms++;
    // else
    // {
    //     gSys.cnt_10ms = 0;
    //     gSys.flags.tick_10ms = 1;
    // }

    /***************************************************************************
     * sysTick 100ms
     **************************************************************************/
    // if (gSys.cnt_100ms <= SYS_TICK_100MS_SET)
    // 	gSys.cnt_100ms++;
    // else
    // {
    // 	gSys.cnt_100ms = 0;
    // 	gSys.flags.tick_100ms = 1;
    // }

    /***************************************************************************
     * sysTick 1s
     * mcu update time
     **************************************************************************/
    // if (gSys.cnt_1s < SYS_TICK_1S_SET - 1)
    //     gSys.cnt_1s++;
    // else
    // {
    //     gSys.cnt_1s = 0;
    //     if (gSys.up_time < 0xFFFFFFFF)
    //         gSys.up_time++;
    //     gSys.flags.tick_1s = 1;
    // }
}

/*******************************************************************************
 * #19
 * Timer3 定时器3
 ******************************************************************************/
void ISR_Timer3_Handler() interrupt 19
{
}

/*******************************************************************************
 * #20
 * Timer4 定时器4
 ******************************************************************************/
void ISR_Timer4_Handler() interrupt 20
{
}

/*******************************************************************************
 * #35
 * TKSU
 ******************************************************************************/
void ISR_HANDLER_35()
{
}
